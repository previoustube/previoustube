## sdkconfig.defaults
```kconfig
CONFIG_ESPTOOLPY_FLASHFREQ_80M=y
CONFIG_ESPTOOLPY_FLASHSIZE_16MB=y
CONFIG_PARTITION_TABLE_CUSTOM=y
CONFIG_COMPILER_CXX_EXCEPTIONS=y
# CONFIG_SPI_MASTER_ISR_IN_IRAM is not set
CONFIG_RMT_ISR_IRAM_SAFE=y
CONFIG_ESP32_REV_MIN_3=y
CONFIG_SPIRAM=y
CONFIG_SPIRAM_SPEED_80M=y
CONFIG_SPIRAM_USE_CAPS_ALLOC=y
CONFIG_ESP_DEFAULT_CPU_FREQ_MHZ_240=y
CONFIG_ESP_SYSTEM_EVENT_TASK_STACK_SIZE=7168
CONFIG_ESP_MAIN_TASK_STACK_SIZE=7168
CONFIG_ESP_INT_WDT_TIMEOUT_MS=300
CONFIG_ESP_WIFI_STATIC_TX_BUFFER=y
CONFIG_FREERTOS_ENABLE_BACKWARD_COMPATIBILITY=y
CONFIG_I2C_HELPER_MASTER_0_SDA=23
CONFIG_I2C_HELPER_MASTER_0_FREQ_HZ=400000
CONFIG_LV_COLOR_16_SWAP=y
CONFIG_LV_MEM_CUSTOM=y
CONFIG_LV_MEMCPY_MEMSET_STD=y
CONFIG_LV_TICK_CUSTOM=y
CONFIG_LV_TICK_CUSTOM_INCLUDE="lvgl_esp_tick_millis.h"
CONFIG_LV_IMG_CACHE_DEF_SIZE=8
CONFIG_LV_USE_ASSERT_STYLE=y
CONFIG_LV_FONT_MONTSERRAT_48=y
CONFIG_LV_USE_FONT_COMPRESSED=y
CONFIG_LV_THEME_DEFAULT_DARK=y
CONFIG_LV_USE_FS_STDIO=y
CONFIG_LV_FS_STDIO_LETTER=83
CONFIG_LV_USE_PNG=y
CONFIG_LV_USE_SJPG=y
CONFIG_LV_USE_QRCODE=y
# CONFIG_LV_BUILD_EXAMPLES is not set
```
